// Generated by scripts/build_quiz_content.py
#pragma once
#include <cstring>
namespace wordmon {
inline const char* correctedMeaning(const char* word, const char* original) {
  struct Correction { const char* word; const char* oldText; const char* newText; };
  static const Correction entries[] = {
    {"crayon box", "크레용", "크레용 상자"},
    {"puzzle piece", "퍼즐", "퍼즐 조각"},
    {"rolling pin", "밀대", "밀방망이"},
    {"pizza slice", "피자", "피자 조각"},
    {"moon", "초승달", "달"},
    {"sushi roll", "김밥", "초밥 롤"},
    {"mop", "밀대", "대걸레"},
    {"dog", "강아지", "개"},
    {"piano keyboard", "피아노", "피아노 건반"},
    {"yarn ball", "털실", "털실 뭉치"},
    {"hair lock", "머리카락", "머리카락 한 타래"},
    {"fern", "고사리 잎", "고사리"},
    {"ticket stub", "표 조각", "표의 반권"},
    {"medicine dropper", "스포이드", "약 스포이트"},
    {"wall anchor", "벽 고정못", "벽 고정 앵커"},
    {"envelope moistener", "봉투 접착기", "봉투 풀 적심 도구"},
    {"soup", "탕", "수프"},
  };
  for(const auto& entry : entries)
    if(!strcmp(word,entry.word) && !strcmp(original,entry.oldText)) return entry.newText;
  return original;
}
inline const char* correctedExample(const char* word, const char* original) {
  struct Correction { const char* word; const char* oldText; const char* newText; };
  static const Correction entries[] = {
    {"crayon box", "She keeps her colors in a crayon box.", "She keeps her crayons in a crayon box."},
    {"glue stick", "Use a glue stick to fix the paper.", "Use a glue stick to stick the paper onto the card."},
    {"whiteboard", "The teacher wrote today on the whiteboard.", "The teacher wrote a word on the whiteboard."},
    {"dresser", "Fold the shirts into the dresser.", "Fold the shirts and put them in the dresser."},
    {"marble", "Shooter marble won the game.", "He rolled a marble across the floor."},
    {"paint roller", "Roll the wall with the paint roller.", "Paint the wall with a paint roller."},
    {"crown", "The king placed the crown on.", "The king put the crown on his head."},
    {"fishing rod", "He cast the fishing rod far.", "He held the fishing rod by the river."},
    {"swim cap", "A swim cap keeps hair dry-ish.", "Put on your swim cap before swimming."},
    {"paint bucket", "Stir the paint bucket well.", "Stir the paint in the paint bucket."},
    {"cereal bowl", "The cereal bowl clinked with milk.", "Pour milk into the cereal bowl."},
    {"noodle bowl", "Slurp the noodle bowl loudly.", "The noodle bowl is full of hot noodles."},
    {"ear", "Music goes in one ear, stays.", "She held the phone to her ear."},
    {"fishbowl", "Goldfish circles the fishbowl.", "A goldfish swims around the fishbowl."},
    {"aloe plant", "Snap an aloe leaf for the burn.", "The aloe plant has thick green leaves."},
    {"fire hydrant", "The dog leashed to the fire hydrant.", "A red fire hydrant stands on the corner."},
    {"garden statue", "A stone rabbit guards the garden statue spot.", "The garden statue looks like a rabbit."},
    {"receipt roll", "The printer spits a receipt roll.", "Put a new receipt roll in the printer."},
    {"barcode scanner", "The barcode scanner beeped red.", "The barcode scanner beeped as it read the code."},
    {"toothbrush holder", "Four slots fill the toothbrush holder.", "The toothbrush holder has four slots."},
    {"medical mask", "A medical mask loops both ears.", "The medical mask has loops for your ears."},
    {"serving tray", "Balance the serving tray steady.", "Hold the serving tray steady."},
    {"motion sensor", "The motion sensor flooded the yard.", "The motion sensor turns on the light."},
    {"desk blotter", "A leather desk blotter anchors the desk.", "A leather desk blotter protects the desk."},
    {"paper cutter", "Guillotine the stack with the paper cutter.", "Cut the paper with a paper cutter."},
  };
  for(const auto& entry : entries)
    if(!strcmp(word,entry.word) && !strcmp(original,entry.oldText)) return entry.newText;
  return original;
}
}
